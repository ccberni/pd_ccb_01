//==================================================================================
//==                                                                              ==
//== Timer module source                                                          ==
//==                                                                              ==
//==================================================================================

//==================================================================================
//== INCLUDES                                                                     ==
//==================================================================================
#include "timer.h"

//==================================================================================
//== PUBLIC VARIABLES                                                             ==
//==================================================================================
bool tmr_1ms    = false;
bool tmr_10ms   = false;
bool tmr_100ms  = false;
bool tmr_1000ms = false;

//==================================================================================
//== PRIVATE VARIABLES                                                            ==
//==================================================================================

//==================================================================================
//== PRIVATE FUNCTIONS PROTOTYPES                                                 ==
//==================================================================================

//==================================================================================
//== PUBLIC FUNCTIONS                                                             ==
//==================================================================================
/**
 * @brief Timer init
 */
void timer_init( void )
{
	tmr_1ms    = false;
	tmr_10ms   = false;
	tmr_100ms  = false;
	tmr_1000ms = false;
}

/**
 * @brief Timer counting bases
 */
void timer_counting_bases( void )
{
	static volatile uint8_t count_10ms	 = 10;
	static volatile uint8_t count_100ms	 = 10;
	static volatile uint8_t count_1000ms = 10;

	// Timer1 - 1ms base
#if ( DGB_TMR_1MS_BASE_TIME == SIM )
	HAL_GPIO_TogglePin(TMR_DEBUG_GPIO_Port, TMR_DEBUG_Pin);
#endif

	// Timer 1 isr rate: 1 ms
	tmr_1ms = 1;

	count_10ms--;
	if ( !count_10ms ) {
		count_10ms = 10;
		tmr_10ms = 1;

		count_100ms--;
		if (!count_100ms) {
			count_100ms = 10;
			tmr_100ms = 1;

			count_1000ms--;
			if (!count_1000ms) {
				count_1000ms = 10;
				tmr_1000ms = 1;
			}
		}
	}
}

//==================================================================================
//== PRIVATE FUNCTIONS                                                            ==
//==================================================================================
